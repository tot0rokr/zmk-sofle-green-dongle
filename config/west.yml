## config/west.yml
```yaml
manifest:
  remotes:
    - name: zmkfirmware
      url-base: https://github.com/zmkfirmware
    - name: gpeye
      url-base: https://github.com/GPeye
    - name: englmaxi
      url-base: https://github.com/englmaxi
  projects:
    - name: mario-peripheral-animation
      remote: gpeye
      revision: main 
    - name: zmk
      remote: zmkfirmware
      revision: f9be3ed9c08b35b1b86df24c0f04913f3b5e50f5  # pinned: last known-good main (2025-11-08, pre-Zephyr-4.1)
      import: app/west.yml
    - name: zmk-dongle-display
      remote: englmaxi
      revision: 4a76cc79069676b4d990c34de1d30d6a869f45ec  # pinned: known-good (2025-10-11), matches pinned zmk
  self:
    path: config
```
